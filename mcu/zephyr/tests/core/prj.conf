## CMakeLists.txt
```
# Copyright (c) 2026 Alloy Robotics
# SPDX-License-Identifier: MIT

cmake_minimum_required(VERSION 3.20.0)
find_package(Zephyr REQUIRED HINTS $ENV{ZEPHYR_BASE})
project(alloy_storage_core_test)

target_sources(app PRIVATE
  src/test_csv.c
  src/test_pool.c
  src/test_policy.c
  src/test_meta.c
)
```

## prj.conf
```kconfig
CONFIG_ZTEST=y
CONFIG_ALLOY_STORAGE_CORE=y
```

## src/test_csv.c
```c
/*
 * Copyright (c) 2026 Alloy Robotics
 * SPDX-License-Identifier: MIT
 */

#include <math.h>
#include <string.h>

#include <zephyr/ztest.h>

#include "alloy_csv.h"

ZTEST_SUITE(alloy_csv, NULL, NULL, NULL, NULL, NULL);

ZTEST(alloy_csv, test_record_header_and_row)
{
	struct alloy_record r;

	alloy_record_init(&r, "imu", 1782715694000000000ULL);
	alloy_record_set(&r, "pitch", 0.52f);
	alloy_record_set(&r, "roll", -1.25f);
	alloy_record_set(&r, "count", 1234567.0f);

	zassert_str_equal(r.chan, "imu");
	zassert_str_equal(r.hdr, "t_ns,pitch,roll,count");
	zassert_str_equal(r.row, "1782715694000000000,0.52,-1.25,1.23457e+06");
	zassert_equal(r.hlen, (int)strlen(r.hdr));
	zassert_equal(r.rlen, (int)strlen(r.row));
	zassert_equal(r.sig, alloy_fnv1a(r.hdr, strlen(r.hdr), ALLOY_FNV_SEED),
		      "signature must equal one pass over the header text");
}

ZTEST(alloy_csv, test_boot_relative_stamp_is_zero_padded)
{
	struct alloy_record r;

	alloy_record_init(&r, "c", 1500000000ULL);
	alloy_record_set(&r, "v", 1.0f);
	zassert_str_equal(r.row, "0000000001500000000,1");
}

ZTEST(alloy_csv, test_nan_and_inf_are_empty_cells)
{
	struct alloy_record r;

	alloy_record_init(&r, "c", 0);
	alloy_record_set(&r, "a", NAN);
	alloy_record_set(&r, "b", INFINITY);
	alloy_record_set(&r, "c", 2.0f);
	zassert_str_equal(r.hdr, "t_ns,a,b,c");
	zassert_str_equal(r.row, "0000000000000000000,,,2");
}

ZTEST(alloy_csv, test_overflowing_field_rolls_back_both)
{
	struct alloy_record r;
	char name[40];
	int fields = 0;

	alloy_record_init(&r, "wide", 0);
	for (int i = 0; i < 100; i++) {
		snprintf(name, sizeof(name), "field_with_long_name_%02d", i);
		alloy_record_set(&r, name, -1.23456f);
	}
	for (const char *p = r.hdr; *p; p++) {
		fields += *p == ',';
	}
	int cells = 0;

	for (const char *p = r.row; *p; p++) {
		cells += *p == ',';
	}
	zassert_true(fields > 0);
	zassert_equal(fields, cells, "header and row must stay aligned");
	zassert_true(r.hlen < ALLOY_HDR_MAX && r.rlen < ALLOY_ROW_MAX);
}

ZTEST(alloy_csv, test_channel_truncated_and_sanitized)
{
	struct alloy_record r;
	char chan[ALLOY_CHAN_MAX];

	alloy_record_init(&r, "a very long channel name with spaces", 0);
	zassert_equal(strlen(r.chan), ALLOY_CHAN_MAX - 1);
	strcpy(chan, r.chan);
	alloy_sanitize_name(chan);
	zassert_str_equal(chan, "a_very_long_channel_nam");
}

ZTEST(alloy_csv, test_empty_channel_is_refused)
{
	struct alloy_record r;

	alloy_record_init(&r, "", 0);
	alloy_record_set(&r, "v", 1.0f);
	zassert_true(r.done);
	zassert_str_equal(r.hdr, "t_ns");
}

ZTEST(alloy_csv, test_rebase_rewrites_only_boot_relative_rows)
{
	char buf[] = "t_ns,v\n"
		     "0000000001000000000,1\n"
		     "1782715694000000000,2\n"
		     "0000000002000000000,3";
	size_t n = alloy_rebase_rows(buf, strlen(buf), 1782715690000000000ULL);

	zassert_equal(n, 2);
	zassert_str_equal(buf, "t_ns,v\n"
			       "1782715691000000000,1\n"
			       "1782715694000000000,2\n"
			       "1782715692000000000,3");
}

ZTEST(alloy_csv, test_rebase_without_offset_is_a_noop)
{
	char buf[] = "t_ns,v\n0000000001000000000,1\n";

	zassert_equal(alloy_rebase_rows(buf, strlen(buf), 0), 0);
	zassert_str_equal(buf, "t_ns,v\n0000000001000000000,1\n");
}
```

## src/test_meta.c
```c
/*
 * Copyright (c) 2026 Alloy Robotics
 * SPDX-License-Identifier: MIT
 */

#include <errno.h>
#include <math.h>

#include <zephyr/ztest.h>

#include "alloy_meta.h"

ZTEST_SUITE(alloy_meta, NULL, NULL, NULL, NULL, NULL);

ZTEST(alloy_meta, test_minimal_sidecar)
{
	char out[256];
	int n = alloy_meta_json(out, sizeof(out), "rover", NULL, "", 1793797593u, NULL, 0);

	zassert_true(n > 0);
	zassert_str_equal(out, "{\"device\":\"rover\",\"session\":\"2026-11-04T13:06:33Z\","
			       "\"fields\":[]}");
	zassert_equal(n, (int)strlen(out));
}

ZTEST(alloy_meta, test_full_sidecar_with_fields)
{
	struct alloy_desc d[2];
	char out[512];

	alloy_desc_set(&d[0], "sample", "wave", "", -1.0f, 1.0f, "generated sine wave");
	alloy_desc_set(&d[1], "batt", "volts", "V", NAN, 12.6f, NULL);
	zassert_true(alloy_meta_json(out, sizeof(out), "esp32-first-mission", "fm-v1",
				     "first Zephyr mission", 0, d, 2) > 0);
	zassert_str_equal(out,
			  "{\"device\":\"esp32-first-mission\",\"firmware\":\"fm-v1\","
			  "\"mission\":\"first Zephyr mission\",\"session\":\"1970-01-01T00:00:00Z\","
			  "\"fields\":[{\"channel\":\"sample\",\"name\":\"wave\",\"min\":-1,\"max\":1,"
			  "\"about\":\"generated sine wave\"},"
			  "{\"channel\":\"batt\",\"name\":\"volts\",\"unit\":\"V\",\"max\":12.6}]}");
}

ZTEST(alloy_meta, test_strings_are_escaped)
{
	char out[256];

	zassert_true(alloy_meta_json(out, sizeof(out), "d", NULL, "say \"hi\"\\\n\t\x01", 0, NULL,
				     0) > 0);
	zassert_not_null(strstr(out, "\"mission\":\"say \\\"hi\\\"\\\\\\n\\t\\u0001\""), "%s",
			 out);
}

ZTEST(alloy_meta, test_desc_strings_are_truncated)
{
	struct alloy_desc d;

	alloy_desc_set(&d, "a_channel_name_longer_than_24", "field_name_longer_than_20",
		       "unit_too_long", 0, 1, NULL);
	zassert_equal(strlen(d.chan), sizeof(d.chan) - 1);
	zassert_equal(strlen(d.field), sizeof(d.field) - 1);
	zassert_equal(strlen(d.unit), sizeof(d.unit) - 1);
	zassert_str_equal(d.about, "");
}

ZTEST(alloy_meta, test_overflow_is_reported)
{
	char out[40];

	zassert_equal(alloy_meta_json(out, sizeof(out), "rover", "v1", "a mission label", 0,
				      NULL, 0),
		      -ENOSPC);
}
```

## src/test_policy.c
```c
/*
 * Copyright (c) 2026 Alloy Robotics
 * SPDX-License-Identifier: MIT
 */

#include <errno.h>

#include <zephyr/ztest.h>

#include "alloy_policy.h"

ZTEST_SUITE(alloy_policy, NULL, NULL, NULL, NULL, NULL);

ZTEST(alloy_policy, test_retryable_statuses)
{
	zassert_true(alloy_retryable_status(-ETIMEDOUT));
	zassert_true(alloy_retryable_status(-ENETDOWN));
	zassert_true(alloy_retryable_status(0));
	zassert_true(alloy_retryable_status(408));
	zassert_true(alloy_retryable_status(425));
	zassert_true(alloy_retryable_status(429));
	zassert_true(alloy_retryable_status(500));
	zassert_true(alloy_retryable_status(503));
	zassert_false(alloy_retryable_status(400));
	zassert_false(alloy_retryable_status(401));
	zassert_false(alloy_retryable_status(403));
	zassert_false(alloy_retryable_status(409));
	zassert_false(alloy_retryable_status(413));
}

ZTEST(alloy_policy, test_backoff_doubles_to_thirty_seconds)
{
	static const uint32_t want[] = {1000, 2000, 4000, 8000, 16000, 30000, 30000, 30000};

	for (uint8_t i = 0; i < ARRAY_SIZE(want); i++) {
		zassert_equal(alloy_retry_delay_ms(i), want[i], "attempt %u", i);
	}
	zassert_equal(alloy_retry_delay_ms(255), 30000);
}

ZTEST(alloy_policy, test_end_gate)
{
	zassert_equal(alloy_end_gate(false, false, 4, 4, 0), ALLOY_END_WAITING, "meta pending");
	zassert_equal(alloy_end_gate(true, true, 3, 4, 0), ALLOY_END_WAITING, "buffer out");
	zassert_equal(alloy_end_gate(true, true, 3, 4, 409), ALLOY_END_WAITING,
		      "failure waits for the drain");
	zassert_equal(alloy_end_gate(true, true, 4, 4, 0), ALLOY_END_READY);
	zassert_equal(alloy_end_gate(true, false, 4, 4, 0), ALLOY_END_FAILED, "meta lost");
	zassert_equal(alloy_end_gate(true, true, 4, 4, -ENOBUFS), ALLOY_END_FAILED, "shed");
	zassert_equal(alloy_end_gate(true, true, 4, 4, 400), ALLOY_END_FAILED, "rejected");
}

ZTEST(alloy_policy, test_http_date_parses_imf_fixdate)
{
	uint32_t e = 0;

	zassert_true(alloy_parse_http_date("Thu, 01 Jan 1970 00:00:00 GMT", &e));
	zassert_equal(e, 0);
	zassert_true(alloy_parse_http_date("Wed, 04 Nov 2026 13:06:33 GMT", &e));
	zassert_equal(e, 1793797593u);
	zassert_true(alloy_parse_http_date("Thu, 29 Feb 2024 23:59:59 GMT", &e));
	zassert_equal(e, 1709251199u);
	zassert_true(alloy_parse_http_date("Tue, 31 Dec 2099 12:00:00 GMT", &e));
	zassert_equal(e, 4102401600u);
}

ZTEST(alloy_policy, test_http_date_rejects_other_forms)
{
	uint32_t e = 7;

	zassert_false(alloy_parse_http_date(NULL, &e));
	zassert_false(alloy_parse_http_date("", &e));
	zassert_false(alloy_parse_http_date("Wednesday, 04-Nov-26 13:06:33 GMT", &e), "RFC 850");
	zassert_false(alloy_parse_http_date("Wed Nov  4 13:06:33 2026", &e), "asctime");
	zassert_false(alloy_parse_http_date("Wed, 04 Nov 2026 13:06:33 UTC", &e));
	zassert_false(alloy_parse_http_date("Wed, 04 Nov 2026 13:06:33 GMT ", &e));
	zassert_false(alloy_parse_http_date("Thu, 30 Feb 2024 00:00:00 GMT", &e));
	zassert_false(alloy_parse_http_date("Thu, 29 Feb 2023 00:00:00 GMT", &e));
	zassert_false(alloy_parse_http_date("Thu, 01 Foo 2024 00:00:00 GMT", &e));
	zassert_false(alloy_parse_http_date("Thu, 01 Jan 1969 00:00:00 GMT", &e));
	zassert_false(alloy_parse_http_date("Thu, 01 Jan 2024 24:00:00 GMT", &e));
	zassert_false(alloy_parse_http_date("Thu, 0x Jan 2024 00:00:00 GMT", &e));
	zassert_equal(e, 7, "output untouched on failure");
}

ZTEST(alloy_policy, test_iso8601_round_trips_with_the_date_parser)
{
	static const struct {
		const char *http;
		const char *iso;
	} cases[] = {
		{"Thu, 01 Jan 1970 00:00:00 GMT", "1970-01-01T00:00:00Z"},
		{"Wed, 04 Nov 2026 13:06:33 GMT", "2026-11-04T13:06:33Z"},
		{"Thu, 29 Feb 2024 23:59:59 GMT", "2024-02-29T23:59:59Z"},
		{"Fri, 01 Mar 2024 00:00:00 GMT", "2024-03-01T00:00:00Z"},
		{"Fri, 31 Dec 2038 23:59:59 GMT", "2038-12-31T23:59:59Z"},
		{"Mon, 01 Jan 2100 00:00:00 GMT", "2100-01-01T00:00:00Z"},
	};
	char iso[21];

	for (size_t i = 0; i < ARRAY_SIZE(cases); i++) {
		uint32_t e;

		zassert_true(alloy_parse_http_date(cases[i].http, &e), "%s", cases[i].http);
		alloy_epoch_to_iso8601(e, iso);
		zassert_str_equal(iso, cases[i].iso);
	}
}

ZTEST(alloy_policy, test_mesh_path_validation)
{
	char long_ok[129];
	char too_long[130];

	memset(long_ok, 'a', 128);
	long_ok[128] = '\0';
	memset(too_long, 'a', 129);
	too_long[129] = '\0';

	zassert_true(alloy_valid_mesh_path("robots/sbr"));
	zassert_true(alloy_valid_mesh_path("hardware-verification/esp32c3-zephyr_1"));
	zassert_true(alloy_valid_mesh_path("a"));
	zassert_true(alloy_valid_mesh_path(long_ok));
	zassert_false(alloy_valid_mesh_path(too_long));
	zassert_false(alloy_valid_mesh_path(NULL));
	zassert_false(alloy_valid_mesh_path(""));
	zassert_false(alloy_valid_mesh_path("/robots"));
	zassert_false(alloy_valid_mesh_path("robots/"));
	zassert_false(alloy_valid_mesh_path("robots sbr"));
	zassert_false(alloy_valid_mesh_path("robots.sbr"));
	zassert_false(alloy_valid_mesh_path("röbots"));
}
```

## src/test_pool.c
```c
/*
 * Copyright (c) 2026 Alloy Robotics
 * SPDX-License-Identifier: MIT
 */

#include <stdio.h>
#include <stdlib.h>
#include <string.h>

#include <zephyr/ztest.h>

#include "alloy_csv.h"
#include "alloy_pool.h"

#define NBUF  4
#define BYTES 12288
#define FLUSH 4000

static char mem[NBUF * BYTES];
static struct alloy_pool pool;

static void reset(void *f)
{
	ARG_UNUSED(f);
	zassert_ok(alloy_pool_init(&pool, mem, NBUF, BYTES, 8, FLUSH));
}

ZTEST_SUITE(alloy_pool, NULL, NULL, reset, NULL, NULL);

static int commit(const char *chan, uint64_t ts, const char *field, float v, uint32_t now)
{
	struct alloy_record r;

	alloy_record_init(&r, chan, ts);
	alloy_record_set(&r, field, v);
	return alloy_pool_commit(&pool, r.chan, r.hdr, r.hlen, r.row, r.rlen, r.sig, now);
}

/* Drains every sealed chunk as an uploader would, appending the bodies to out. */
static size_t drain(char *out, size_t cap)
{
	size_t len = 0;
	uint8_t idx;

	while (alloy_pool_take(&pool, &idx)) {
		struct alloy_buf *b = &pool.bufs[idx];

		zassert_true(len + b->len < cap);
		memcpy(out + len, b->data, b->len);
		len += b->len;
		alloy_pool_release(&pool, idx);
	}
	out[len] = '\0';
	return len;
}

ZTEST(alloy_pool, test_first_row_carries_the_header)
{
	uint8_t idx;

	zassert_ok(commit("imu", 1, "pitch", 1.0f, 0));
	zassert_ok(commit("imu", 2, "pitch", 2.0f, 10));
	alloy_pool_seal_all(&pool);
	zassert_true(alloy_pool_take(&pool, &idx));
	zassert_str_equal(pool.bufs[idx].chan, "imu");
	pool.bufs[idx].data[pool.bufs[idx].len] = '\0';
	zassert_str_equal(pool.bufs[idx].data, "t_ns,pitch\n"
					       "0000000000000000001,1\n"
					       "0000000000000000002,2\n");
}

ZTEST(alloy_pool, test_buffer_channel_name_is_sanitized)
{
	uint8_t idx;

	zassert_ok(commit("left wheel", 1, "rpm", 1.0f, 0));
	alloy_pool_seal_all(&pool);
	zassert_true(alloy_pool_take(&pool, &idx));
	zassert_str_equal(pool.bufs[idx].chan, "left_wheel");
}

ZTEST(alloy_pool, test_timed_flush_seals_when_nothing_is_queued)
{
	zassert_ok(commit("a", 1, "v", 1.0f, 0));
	zassert_ok(commit("a", 2, "v", 1.0f, FLUSH - 1));
	zassert_equal(alloy_pool_pending_count(&pool), 0);
	zassert_ok(commit("a", 3, "v", 1.0f, FLUSH));
	zassert_equal(alloy_pool_pending_count(&pool), 1, "flush interval elapsed");
	zassert_equal(alloy_pool_free_count(&pool), NBUF - 2, "replacement claimed atomically");
}

ZTEST(alloy_pool, test_timed_flush_waits_while_a_chunk_is_queued)
{
	/* The outage fix: with a sealed chunk still waiting, keep filling instead of sealing
	 * part-full buffers on the timer.
	 */
	zassert_ok(commit("a", 1, "v", 1.0f, 0));
	zassert_ok(commit("a", 2, "v", 1.0f, FLUSH));
	zassert_equal(alloy_pool_pending_count(&pool), 1);
	for (uint32_t t = FLUSH; t < 10 * FLUSH; t += 100) {
		zassert_ok(commit("a", t, "v", 1.0f, t));
	}
	zassert_equal(alloy_pool_pending_count(&pool), 1, "no timed seal while backlogged");
	zassert_equal(alloy_pool_flush_due(&pool, 20 * FLUSH), 0, "idle flush also waits");
}

ZTEST(alloy_pool, test_idle_flush_seals_due_channels)
{
	zassert_ok(commit("a", 1, "v", 1.0f, 0));
	zassert_equal(alloy_pool_flush_due(&pool, FLUSH - 1), 0);
	zassert_equal(alloy_pool_flush_due(&pool, FLUSH), 1);
	zassert_equal(alloy_pool_pending_count(&pool), 1);
}

ZTEST(alloy_pool, test_ninety_percent_full_seals)
{
	uint32_t rows = 0;

	while (alloy_pool_pending_count(&pool) == 0) {
		zassert_ok(commit("a", rows, "v", 123.456f, 0));
		rows++;
	}
	uint8_t idx;

	zassert_true(alloy_pool_take(&pool, &idx));
	zassert_true(pool.bufs[idx].len >= BYTES * 9 / 10);
	zassert_true(pool.bufs[idx].len <= BYTES);
}

ZTEST(alloy_pool, test_field_set_change_starts_a_new_chunk)
{
	char out[256];
	struct alloy_record r;

	zassert_ok(commit("a", 1, "x", 1.0f, 0));
	alloy_record_init(&r, "a", 2);
	alloy_record_set(&r, "x", 2.0f);
	alloy_record_set(&r, "y", 3.0f);
	zassert_ok(alloy_pool_commit(&pool, r.chan, r.hdr, r.hlen, r.row, r.rlen, r.sig, 1));
	zassert_equal(alloy_pool_pending_count(&pool), 1);
	alloy_pool_seal_all(&pool);
	drain(out, sizeof(out));
	zassert_str_equal(out, "t_ns,x\n0000000000000000001,1\n"
			       "t_ns,x,y\n0000000000000000002,2,3\n");
}

ZTEST(alloy_pool, test_sheds_oldest_pending_only_when_no_buffer_is_free)
{
	/* Fill all four buffers on four channels and seal three: one active, three pending,
	 * none free. A fifth channel can only get a buffer by shedding the oldest chunk.
	 */
	zassert_ok(alloy_pool_init(&pool, mem, NBUF, BYTES, 8, FLUSH));
	for (int c = 0; c < 4; c++) {
		char chan[4];

		snprintf(chan, sizeof(chan), "c%d", c);
		zassert_ok(commit(chan, 1, "v", 1.0f, 0));
	}
	zassert_equal(alloy_pool_free_count(&pool), 0);
	zassert_equal(alloy_pool_flush_due(&pool, FLUSH), 0, "no replacement, so no timed seal");
	zassert_equal(pool.dropped_bufs, 0);
	alloy_pool_seal_all(&pool);
	zassert_equal(alloy_pool_pending_count(&pool), 4);

	zassert_ok(commit("c4", 2, "v", 1.0f, FLUSH));
	zassert_equal(pool.dropped_bufs, 1, "oldest pending shed for the new channel");
	zassert_equal(alloy_pool_pending_count(&pool), 3);
}

ZTEST(alloy_pool, test_never_sheds_the_chunk_just_sealed)
{
	/* Two 230-byte buffers, one in flight. 74-byte rows overflow the buffer before it reaches
	 * the 90% seal, so the overflow path seals it into the only pending slot and must drop the
	 * incoming row rather than recycle the chunk it just sealed.
	 */
	struct alloy_record r;
	uint8_t inflight;
	int rc = 0;

	zassert_ok(alloy_pool_init(&pool, mem, 2, 230, 8, FLUSH));
	zassert_ok(commit("a", 0, "v", 1.0f, 0));
	alloy_pool_seal_all(&pool);
	zassert_true(alloy_pool_take(&pool, &inflight));

	for (int i = 0; i < 4 && rc == 0; i++) {
		alloy_record_init(&r, "b", (uint64_t)i);
		for (char f = 'a'; f <= 'f'; f++) {
			char name[2] = {f, '\0'};

			alloy_record_set(&r, name, -1.23456f);
		}
		rc = alloy_pool_commit(&pool, r.chan, r.hdr, r.hlen, r.row, r.rlen, r.sig, 0);
	}
	zassert_equal(rc, -ENOSPC);
	zassert_equal(pool.dropped_bufs, 0, "the sealed chunk survives");
	zassert_equal(pool.dropped_rows, 1);
	zassert_equal(alloy_pool_pending_count(&pool), 1);
	zassert_equal(pool.bufs[pool.pending_q.idx[pool.pending_q.head]].len, 17 + 2 * 74);
}

ZTEST(alloy_pool, test_rejects_oversize_rows_and_extra_channels)
{
	char out[64];

	zassert_ok(alloy_pool_init(&pool, mem, NBUF, 64, 2, FLUSH));
	struct alloy_record r;

	alloy_record_init(&r, "a", 0);
	alloy_record_set(&r, "a_rather_long_field_name", 1.0f);
	alloy_record_set(&r, "another_long_field_name", 2.0f);
	zassert_equal(alloy_pool_commit(&pool, r.chan, r.hdr, r.hlen, r.row, r.rlen, r.sig, 0),
		      -ENOSPC);
	zassert_ok(commit("a", 0, "v", 1.0f, 0));
	zassert_ok(commit("b", 0, "v", 1.0f, 0));
	zassert_equal(commit("c", 0, "v", 1.0f, 0), -ENOSPC);
	zassert_equal(pool.dropped_rows, 2);
	alloy_pool_seal_all(&pool);
	drain(out, sizeof(out));
}

ZTEST(alloy_pool, test_seal_all_frees_empty_buffers)
{
	zassert_ok(commit("a", 1, "v", 1.0f, 0));
	zassert_ok(commit("a", 2, "v", 1.0f, FLUSH)); /* timed seal, fresh empty active */
	zassert_equal(alloy_pool_free_count(&pool), NBUF - 2);
	alloy_pool_seal_all(&pool);
	zassert_equal(alloy_pool_pending_count(&pool), 1);
	zassert_equal(alloy_pool_free_count(&pool), NBUF - 1);
}

/* Gate 3 in the lab, in miniature: 20 Hz sequence counter (~30 B/row, as on the C3), the
 * uploader stuck for 25 s from the moment the first chunk is queued, then the backlog drains.
 * Every value must come out exactly once and nothing may be shed.
 */
ZTEST(alloy_pool, test_outage_keeps_every_row)
{
	static char out[NBUF * BYTES * 4];
	uint32_t now = 0;
	uint32_t seq = 0;
	uint32_t outage_start = UINT32_MAX;
	size_t len = 0;

	for (; now < 70000; now += 50) {
		bool outage = outage_start != UINT32_MAX && now - outage_start < 25000;
		struct alloy_record r;

		alloy_record_init(&r, "seq", 1782715694000000000ULL + (uint64_t)now * 1000000ULL);
		alloy_record_set(&r, "seq", (float)seq++);
		alloy_record_set(&r, "t_s", (float)now / 1000.0f);
		zassert_ok(alloy_pool_commit(&pool, r.chan, r.hdr, r.hlen, r.row, r.rlen, r.sig,
					     now));
		if (outage_start == UINT32_MAX && alloy_pool_pending_count(&pool) > 0) {
			outage_start = now;
		}
		if (!outage && now % 250 == 0) {
			alloy_pool_flush_due(&pool, now);
			len += drain(out + len, sizeof(out) - len);
		}
	}
	alloy_pool_seal_all(&pool);
	len += drain(out + len, sizeof(out) - len);
	zassert_equal(pool.dropped_bufs, 0, "outage shed a buffer");
	zassert_equal(pool.dropped_rows, 0);

	/* Every sequence value exactly once, in order. */
	uint32_t expect = 0;
	char *line = strtok(out, "\n");

	while (line) {
		if (strncmp(line, "t_ns", 4) != 0) {
			char *comma = strchr(line, ',');

			zassert_not_null(comma);
			zassert_equal((uint32_t)strtoul(comma + 1, NULL, 10), expect, "row %u",
				      expect);
			expect++;
		}
		line = strtok(NULL, "\n");
	}
	zassert_equal(expect, seq);
}
```
